## CMakeLists.txt
```
cmake_minimum_required(VERSION 3.20.0)
find_package(Zephyr REQUIRED HINTS $ENV{ZEPHYR_BASE})
project(Ohjelmistokehitys-week3)

target_sources(app PRIVATE
  src/main.c
  src/TimeParser.c
)
```

## prj.conf
```kconfig
CONFIG_HEAP_MEM_POOL_SIZE=1024
CONFIG_STDOUT_CONSOLE=y
```

## src/main.c
```c
#include <zephyr/kernel.h>
#include <zephyr/sys/printk.h>
#include <zephyr/device.h>
#include <zephyr/drivers/gpio.h>
#include <zephyr/drivers/uart.h>
#include "TimeParser.h"

static void timeout_handler(struct k_timer *timer);
K_TIMER_DEFINE(time_trigger, timeout_handler, NULL);

// Thread initializations
#define STACKSIZE 500
#define PRIORITY 5

K_SEM_DEFINE(release_sem, 0, 1);

//contidion variables 
K_MUTEX_DEFINE(red_mutex);
K_CONDVAR_DEFINE(red_signal);
K_MUTEX_DEFINE(green_mutex);
K_CONDVAR_DEFINE(green_signal);
K_MUTEX_DEFINE(yellow_mutex);
K_CONDVAR_DEFINE(yellow_signal);

// Valotaskien prototyypit
void red_task(void *a, void *b, void *c);
void green_task(void *a, void *b, void *c);
void yellow_task(void *a, void *b, void *c);


K_THREAD_DEFINE(red_thread, STACKSIZE, red_task, NULL, NULL, NULL, PRIORITY, 0, 0);
K_THREAD_DEFINE(green_thread, STACKSIZE, green_task, NULL, NULL, NULL, PRIORITY, 0, 0);
K_THREAD_DEFINE(yellow_thread, STACKSIZE, yellow_task, NULL, NULL, NULL, PRIORITY, 0, 0);


// UART initialization
#define UART_DEVICE_NODE DT_CHOSEN(zephyr_shell_uart)
static const struct device *const uart_dev = DEVICE_DT_GET(UART_DEVICE_NODE);


// Create dispatcher FIFO buffer
K_FIFO_DEFINE(dispatcher_fifo);

// FIFO dispatcher data type
struct data_t {
	void *fifo_reserved;
	char msg[20]; 
};

int init_uart(void) {
	// UART initialization
	if (!device_is_ready(uart_dev)) {
		return 1;
	} 
	return 0;
}

int main(void)
{
	int ret = init_uart();
	if (ret != 0) {
		//printk("UART initialization failed!\n");
		return ret;
	}
        //printk("System started!\n"); 
	return 0;
}

/********************
 * UART task
 */
void uart_task(void *unused1, void *unused2, void *unused3)
{
    char rc = 0;
    char uart_msg[20];
    memset(uart_msg, 0, 20);
    int uart_msg_cnt = 0;

    while (true) {
        // Ask UART if data available
        if (uart_poll_in(uart_dev, &rc) == 0) {

            // Jos vastaanotettu merkki ei ole rivinvaihto, lisätään puskurin loppuun
            if (rc != '\r') {
                if (uart_msg_cnt < (int)(sizeof(uart_msg) - 1)) {
                    uart_msg[uart_msg_cnt] = rc;
                    uart_msg_cnt++;
                }
            } else {
                // Viesti valmis (\r vastaanotettu)
                // Jos pituus on 6 merkkiä, parsitaan aika
                if (strlen(uart_msg) == 6) {
                    int delay_s = time_parse(uart_msg);
                    printk("RES:%d\n", delay_s);
                    if (delay_s >= 0) {
                        printk("Valid time: %s -> %d s\n", uart_msg, delay_s);
                        k_timer_start(&time_trigger, K_SECONDS(delay_s), K_NO_WAIT);
                    } else {
                        printk("Invalid time string: %s (error %d)\n", uart_msg, delay_s);
                    }
                }

                // Lähetetään dispatcherille
                struct data_t *buf = k_malloc(sizeof(struct data_t));
                if (buf == NULL) {
                    return;
                }
                snprintf(buf->msg, 20, "%s", uart_msg);
                k_fifo_put(&dispatcher_fifo, buf);

                // Tyhjennetään puskuri
                uart_msg_cnt = 0;
                memset(uart_msg, 0, 20);
            }
        }

        k_msleep(10);
    }
}


/********************
 * Dispatcher task
 */
void dispatcher_task(void *unused1, void *unused2, void *unused3)
{
	while (true) {
		// Receive dispatcher data from uart_task fifo
		struct data_t *rec_item = k_fifo_get(&dispatcher_fifo, K_FOREVER);
		char sequence[20];
		memcpy(sequence,rec_item->msg,20);
		k_free(rec_item);

		//printk("Dispatcher: %s\n", sequence);

		uint64_t seq_start_us = k_ticks_to_us_floor64(k_uptime_ticks());

        		// 2. Käy sekvenssi läpi kirjain kerrallaan (esim. "RYG")
		for (int i = 0; i < strlen(sequence); i++) {
			char color = sequence[i];
			//printk("Next color: %c\n", color);

			// 3. Lähetä signaali oikealle valotaskille
			if (color == 'R') {
				k_mutex_lock(&red_mutex, K_FOREVER);
				k_condvar_signal(&red_signal);
				k_mutex_unlock(&red_mutex);
			} else if (color == 'Y') {
				k_mutex_lock(&yellow_mutex, K_FOREVER);
				k_condvar_signal(&yellow_signal);
				k_mutex_unlock(&yellow_mutex);
			} else if (color == 'G') {
				k_mutex_lock(&green_mutex, K_FOREVER);
				k_condvar_signal(&green_signal);
				k_mutex_unlock(&green_mutex);
			}

			// 4. Odota, että valotaski ilmoittaa olevansa valmis
			k_sem_take(&release_sem, K_FOREVER);
		}
		uint64_t seq_end_us = k_ticks_to_us_floor64(k_uptime_ticks());
		uint64_t seq_duration_us = seq_end_us - seq_start_us;

		printk("Total sequence time: %llu us\n", seq_duration_us);
	}
}




static void timeout_handler(struct k_timer *timer)
{
    printk("Timer triggered -> red signal\n");
    k_mutex_lock(&red_mutex, K_FOREVER);
    k_condvar_signal(&red_signal);
    k_mutex_unlock(&red_mutex);
}



void red_task(void *a, void *b, void *c) {
    while (1) {
        k_mutex_lock(&red_mutex, K_FOREVER);
        k_condvar_wait(&red_signal, &red_mutex, K_FOREVER);
        k_mutex_unlock(&red_mutex);

		uint32_t start = k_cycle_get_32();
        //printk("Red on\n");
        k_msleep(500); // simulaatio, valon kesto
        //printk("Red off\n");
		uint32_t end = k_cycle_get_32();

		uint32_t elapsed_us = k_ticks_to_us_ceil32(end - start);
        printk("Red task duration: %u us\n", elapsed_us);

        // Ilmoitetaan dispatcherille että tehtävä valmis
        k_sem_give(&release_sem);
    }
}

void green_task(void *a, void *b, void *c) {
    while (1) {
        k_mutex_lock(&green_mutex, K_FOREVER);
        k_condvar_wait(&green_signal, &green_mutex, K_FOREVER);
        k_mutex_unlock(&green_mutex);

		uint32_t start = k_cycle_get_32();
        //printk("Green on\n");
        k_msleep(500);
        //printk("Green off\n");
		uint32_t end = k_cycle_get_32();

		uint32_t elapsed_us = k_ticks_to_us_ceil32(end - start);
        printk("Green task duration: %u us\n", elapsed_us);


        k_sem_give(&release_sem);
    }
}

void yellow_task(void *a, void *b, void *c) {
    while (1) {
        k_mutex_lock(&yellow_mutex, K_FOREVER);
        k_condvar_wait(&yellow_signal, &yellow_mutex, K_FOREVER);
        k_mutex_unlock(&yellow_mutex);

		uint32_t start = k_cycle_get_32();
        //printk("Yellow on\n");
        k_msleep(500);
        //printk("Yellow off\n");
		uint32_t end = k_cycle_get_32();

		uint32_t elapsed_us = k_ticks_to_us_ceil32(end - start);
        printk("Yellow task duration: %u us\n", elapsed_us);

        k_sem_give(&release_sem);
    }
}

K_THREAD_DEFINE(dis_thread,STACKSIZE,dispatcher_task,NULL,NULL,NULL,PRIORITY,0,0);
K_THREAD_DEFINE(uart_thread,STACKSIZE,uart_task,NULL,NULL,NULL,PRIORITY,0,0);
```

## src/TimeParser.c
```c
#include <stdlib.h>
#include <string.h>
#include <ctype.h>
#include "TimeParser.h"

// time format: HHMMSS (6 characters)
int time_parse(char *time) {
    if (time == NULL) return TIME_ARRAY_ERROR;
    if (strlen(time) != 6) return TIME_LEN_ERROR;

    for (int i = 0; i < 6; i++) {
        if (!isdigit((unsigned char)time[i])) return TIME_VALUE_ERROR;
    }

    int hours = (time[0]-'0')*10 + (time[1]-'0');
    int minutes = (time[2]-'0')*10 + (time[3]-'0');
    int seconds = (time[4]-'0')*10 + (time[5]-'0');

    if (hours < 0 || hours > 23) return TIME_VALUE_ERROR;
    if (minutes < 0 || minutes > 59) return TIME_VALUE_ERROR;
    if (seconds < 0 || seconds > 59) return TIME_VALUE_ERROR;

    return minutes * 60 + seconds;
}
```

## src/TimeParser.h
```c
#ifndef TIMEPARSER_H
#define TIMEPARSER_H

#ifdef __cplusplus
extern "C" {
#endif

#define TIME_LEN_ERROR   -1
#define TIME_VALUE_ERROR -2
#define TIME_ARRAY_ERROR -3

int time_parse(char *time);

#ifdef __cplusplus
}
#endif

#endif
```
